## CMakeLists.txt
```
# RunBMC Firmware Framework Build System
# SPDX-License-Identifier: Apache-2.0
# Copyright (c) 2026 RunBMC Project

cmake_minimum_required(VERSION 3.20.0)

find_package(Zephyr REQUIRED HINTS $ENV{ZEPHYR_BASE})
project(runbmc_framework VERSION 0.2.0)

message(STATUS "========================================")
message(STATUS "RunBMC Firmware Framework v${PROJECT_VERSION}")
message(STATUS "Target Board: ${BOARD}")
message(STATUS "========================================")

# Framework version definitions
zephyr_compile_definitions(
  RUNBMC_VERSION_MAJOR=0
  RUNBMC_VERSION_MINOR=2
  RUNBMC_VERSION_PATCH=0
)

# Framework include directories
target_include_directories(app PRIVATE
  ${CMAKE_CURRENT_SOURCE_DIR}/include
)

# Core framework files (always compiled)
target_sources(app PRIVATE
  src/main.c
  src/core/bmc_core.c
)

# BMC Core Services (conditional compilation)
if(CONFIG_RUNBMC_POWER_MANAGEMENT)
  message(STATUS "  [x] Power Management Service")
  target_sources(app PRIVATE src/core/power.c)
else()
  message(STATUS "  [ ] Power Management Service")
endif()

if(CONFIG_RUNBMC_SENSOR_FRAMEWORK)
  message(STATUS "  [x] Sensor Framework")
  target_sources(app PRIVATE src/core/sensors.c)
else()
  message(STATUS "  [ ] Sensor Framework")
endif()

if(CONFIG_RUNBMC_TELEMETRY)
  message(STATUS "  [x] Telemetry Engine")
  target_sources(app PRIVATE src/core/telemetry.c)
else()
  message(STATUS "  [ ] Telemetry Engine")
endif()

if(CONFIG_RUNBMC_THERMAL_MANAGEMENT)
  message(STATUS "  [x] Thermal Management")
  target_sources(app PRIVATE src/core/thermal.c)
else()
  message(STATUS "  [ ] Thermal Management")
endif()

# Shell interface (if enabled)
if(CONFIG_SHELL)
  message(STATUS "  [x] Shell/CLI Interface")
  target_sources(app PRIVATE src/shell/shell_bmc.c)
endif()

# Platform abstraction layer
if(BOARD MATCHES "qemu_riscv.*")
  message(STATUS "  [x] QEMU RISC-V Platform HAL")
  target_sources(app PRIVATE src/platform/qemu_riscv.c)
elseif(BOARD STREQUAL "stm32f4_disco")
  message(STATUS "  [x] STM32F4 Discovery Platform HAL")
  target_sources(app PRIVATE src/platform/stm32f4_disco.c)
else()
  message(WARNING "  [!] Unknown platform, using generic HAL")
  target_sources(app PRIVATE src/platform/generic.c)
endif()

# Protocol support (future - Day 2+)
if(CONFIG_RUNBMC_PLDM)
  message(STATUS "  [x] PLDM Protocol (placeholder)")
  # Future: target_sources(app PRIVATE src/protocols/pldm/pldm_base.c)
else()
  message(STATUS "  [ ] PLDM Protocol")
endif()

# MCTP Transport Layer
if(CONFIG_RUNBMC_MCTP)
    target_sources(app PRIVATE src/protocols/mctp_core.c)
    message(STATUS "  [x] MCTP Protocol")

    if(CONFIG_RUNBMC_MCTP_I2C)
        target_sources(app PRIVATE src/protocols/mctp_i2c.c)
        message(STATUS "      - I2C Binding")
    endif()

    if(CONFIG_RUNBMC_MCTP_UART)
        target_sources(app PRIVATE src/protocols/mctp_uart.c)
        message(STATUS "      - UART Binding")
    endif()

    if(CONFIG_SHELL)
        target_sources(app PRIVATE src/shell/shell_mctp.c)
    endif()
else()
    message(STATUS "  [ ] MCTP Protocol")
endif()

if(CONFIG_RUNBMC_FRU)
  message(STATUS "  [x] FRU Management (placeholder)")
  # Future: target_sources(app PRIVATE src/services/fru_manager.c)
else()
  message(STATUS "  [ ] FRU Management")
endif()

message(STATUS "========================================")
```

## Kconfig
```
# RunBMC Firmware Framework Configuration
# Copyright (c) 2026 RunBMC Project
# SPDX-License-Identifier: Apache-2.0

mainmenu "RunBMC Firmware Framework"

config RUNBMC_VERSION_STRING
    string "Framework version"
    default "0.2.0-dev"
    help
      Version string for the RunBMC firmware framework

menu "BMC Core Services"

config RUNBMC_POWER_MANAGEMENT
    bool "Power Management Service"
    default y
    help
      Enable BMC power management including:
      - Power sequencing (voltage rail ordering)
      - Power state control (S0/S5)
      - Power monitoring and budgeting
      - GPU power management

config RUNBMC_SENSOR_FRAMEWORK
    bool "Sensor Framework"
    default y
    help
      Enable multi-sensor monitoring framework:
      - Temperature sensors (CPU, GPU, VR, ambient)
      - Voltage/current sensors
      - Fan tachometer
      - Sensor Data Records (SDR)

config RUNBMC_TELEMETRY
    bool "Telemetry Collection Engine"
    default y
    help
      Enable telemetry data collection:
      - Historical sensor data
      - System metrics
      - Statistical analysis (min/max/avg)
      - Time-series storage

config RUNBMC_THERMAL_MANAGEMENT
    bool "Thermal Management"
    default n
    depends on RUNBMC_SENSOR_FRAMEWORK
    help
      Enable thermal zone management:
      - Thermal zones (CPU, GPU, VR)
      - Fan control (PID algorithm)
      - Thermal trip points
      - Throttling policies

endmenu

menu "Management Protocols"

config RUNBMC_PLDM
    bool "PLDM Protocol Support"
    default n
    help
      Enable Platform Level Data Model (PLDM) per DMTF DSP0248.
      Required for modern BMC interfaces.

#
# MCTP Transport Protocol
#
config RUNBMC_MCTP
    bool "MCTP Transport Layer"
    default n
    help
      Enable MCTP (Management Component Transport Protocol) support.
      Implements DMTF DSP0236 specification.

if RUNBMC_MCTP

config RUNBMC_MCTP_I2C
    bool "MCTP over I2C binding"
    default n
    select I2C
    help
      Enable MCTP over I2C transport binding (DSP0237).
      Typically used on STM32F4 and other microcontrollers.

config RUNBMC_MCTP_UART
    bool "MCTP over UART binding"
    default n
    select UART_INTERRUPT_DRIVEN
    help
      Enable MCTP over UART transport binding (DSP0253).
      Typically used on QEMU and systems with serial ports.

config RUNBMC_MCTP_EID
    hex "MCTP Local Endpoint ID"
    default 0x08
    range 0x08 0xFE
    help
      Local MCTP Endpoint ID (EID) for this BMC.
      Valid range: 0x08 to 0xFE (0x00=NULL, 0xFF=Broadcast).

endif # RUNBMC_MCTP

config RUNBMC_FRU
    bool "FRU Data Management"
    default n
    help
      Enable Field Replaceable Unit (FRU) data management
      per IPMI FRU specification. Stores hardware inventory.

config RUNBMC_REDFISH
    bool "Redfish API Support"
    default n
    help
      Enable Redfish RESTful API (DMTF standard).
      Requires networking support.

endmenu

menu "Hardware Configuration"

config RUNBMC_MAX_GPUS
    int "Maximum GPU count"
    range 1 16
    default 8
    help
      Maximum number of GPU accelerators to monitor.
      Affects memory usage for GPU-related data structures.

config RUNBMC_SENSOR_POLL_INTERVAL_MS
    int "Sensor polling interval (ms)"
    range 1000 60000
    default 5000
    help
      How frequently to poll hardware sensors.
      Lower = more responsive, higher CPU usage.

config RUNBMC_TELEMETRY_INTERVAL_MS
    int "Telemetry collection interval (ms)"
    range 1000 60000
    default 5000
    help
      How frequently to collect telemetry snapshots.

endmenu

source "Kconfig.zephyr"
```

## sample.yaml
```
sample:
  description: RunBMC - Baseboard Management Controller implementation
    on Zephyr RTOS with multi-threaded architecture for power management,
    sensor monitoring, and telemetry collection
  name: RunBMC
common:
  min_ram: 16
  tags: bmc management sensors power telemetry shell
  integration_platforms:
    - qemu_riscv32
    - qemu_riscv64
  harness: console
  harness_config:
    type: multi_line
    ordered: true
    regex:
      - "RunBMC - Baseboard Management Controller"
      - "Initializing RunBMC..."
      - "Power management thread started"
      - "Sensor thread started"
      - "Telemetry thread started"
      - "All BMC threads started successfully"
      - "System ready"
tests:
  sample.runbmc.basic:
    tags: bmc shell threads
    platform_allow: qemu_riscv32 qemu_riscv64
    min_ram: 16
```

## prj.conf
```kconfig
# RunBMC Firmware Framework - Base Configuration
# Copyright (c) 2026 RunBMC Project
# SPDX-License-Identifier: Apache-2.0

# Default BMC services
CONFIG_RUNBMC_POWER_MANAGEMENT=y
CONFIG_RUNBMC_SENSOR_FRAMEWORK=y
CONFIG_RUNBMC_TELEMETRY=y

# Zephyr RTOS core
CONFIG_MULTITHREADING=y
CONFIG_SYS_CLOCK_TICKS_PER_SEC=1000

# Thread configuration
CONFIG_THREAD_NAME=y
CONFIG_THREAD_MONITOR=y
CONFIG_THREAD_STACK_INFO=y

# Memory configuration
CONFIG_MAIN_STACK_SIZE=2048
CONFIG_SYSTEM_WORKQUEUE_STACK_SIZE=2048
CONFIG_IDLE_STACK_SIZE=512
CONFIG_HEAP_MEM_POOL_SIZE=4096

# Logging framework (backends configured per-board)
CONFIG_LOG=y
CONFIG_LOG_DEFAULT_LEVEL=3
CONFIG_LOG_PRINTK=y

# Console and printk (backends configured per-board)
CONFIG_CONSOLE=y
CONFIG_PRINTK=y
CONFIG_EARLY_CONSOLE=y

# Note: Console backend (UART vs SWO) is configured in boards/*.conf
# - boards/qemu_riscv32.conf: UART console + shell
# - boards/stm32f4_disco.conf: SWO console (no shell)
```

## boards/qemu_riscv32.conf
```kconfig
# QEMU RISC-V32 Board-Specific Configuration

# UART Console for shell
CONFIG_SERIAL=y
CONFIG_UART_CONSOLE=y
CONFIG_CONSOLE=y

# Shell via UART
CONFIG_SHELL=y
CONFIG_SHELL_BACKEND_SERIAL=y
CONFIG_SHELL_PROMPT_UART="runbmc:~$ "

# Logging - disable UART backend to prevent duplication
CONFIG_LOG=y
CONFIG_LOG_MODE_IMMEDIATE=y
CONFIG_LOG_BACKEND_UART=n
CONFIG_LOG_BACKEND_SHOW_COLOR=y

# Printk support
CONFIG_PRINTK=y
CONFIG_EARLY_CONSOLE=y

# Force console to be ready early for banner
CONFIG_UART_CONSOLE_DEBUG_SERVER_HOOKS=y

# MCTP Transport - DISABLED on QEMU (only 1 UART conflicts with console)
# Test MCTP I2C simulation instead or use real hardware for UART testing
CONFIG_RUNBMC_MCTP=n
# CONFIG_RUNBMC_MCTP_UART=y
# CONFIG_UART_INTERRUPT_DRIVEN=y
```

## boards/stm32f4_disco.conf
```kconfig
# STM32F4 Discovery Board-Specific Configuration
# This overlay is automatically applied when building for stm32f4_disco

# GPIO for LEDs (PD12-PD15)
CONFIG_GPIO=y

# Enable UART Console for interactive shell
CONFIG_UART_CONSOLE=y
CONFIG_SERIAL=y
CONFIG_CONSOLE=y

# Enable Shell via UART
CONFIG_SHELL=y
CONFIG_SHELL_BACKEND_SERIAL=y
CONFIG_SHELL_PROMPT_UART="runbmc:~$ "

# Logging - disable UART backend to prevent duplication
# Shell backend will display logs
CONFIG_LOG_BACKEND_UART=n

# Printk support
CONFIG_PRINTK=y
CONFIG_EARLY_CONSOLE=y

# MCTP Transport - I2C binding for STM32F4
CONFIG_RUNBMC_MCTP=y
CONFIG_RUNBMC_MCTP_I2C=y
CONFIG_I2C=y
```

## src/main.c
```c
/*
 * Copyright (c) 2026 RunBMC Project
 * SPDX-License-Identifier: Apache-2.0
 */

#include <zephyr/kernel.h>
#include <zephyr/logging/log.h>

#include "runbmc/core/bmc.h"
#include "runbmc/core/platform.h"

LOG_MODULE_REGISTER(runbmc_main, LOG_LEVEL_INF);

int main(void)
{
    /* Wait for console to be ready (especially needed for QEMU) */
    k_msleep(50);

    /* Print banner */
    printk("\n");
    printk("====================================================\n");
    printk("       RunBMC - BMC Firmware Framework on MCU\n");
    printk("            on Zephyr RTOS\n");
    printk("====================================================\n");
    printk("RunBMC:     v%d.%d.%d\n", RUNBMC_VERSION_MAJOR, RUNBMC_VERSION_MINOR,
           RUNBMC_VERSION_PATCH);
    printk("Zephyr:     v4.2.99\n");
    printk("Platform:   %s\n", platform_get_name());
    printk("Build:      %s %s\n", __DATE__, __TIME__);
    printk("====================================================\n");
    printk("Enabled Features:\n");

#ifdef CONFIG_RUNBMC_POWER_MANAGEMENT
    printk("  [x] Power Management\n");
#else
    printk("  [ ] Power Management\n");
#endif

#ifdef CONFIG_RUNBMC_SENSOR_FRAMEWORK
    printk("  [x] Sensor Framework (%d GPUs)\n", CONFIG_RUNBMC_MAX_GPUS);
#else
    printk("  [ ] Sensor Framework\n");
#endif

#ifdef CONFIG_RUNBMC_TELEMETRY
    printk("  [x] Telemetry Collection\n");
#else
    printk("  [ ] Telemetry Collection\n");
#endif

#ifdef CONFIG_RUNBMC_THERMAL
    printk("  [x] Thermal Management\n");
#else
    printk("  [ ] Thermal Management\n");
#endif

#ifdef CONFIG_RUNBMC_PLDM
    printk("  [x] PLDM Protocol\n");
#else
    printk("  [ ] PLDM Protocol\n");
#endif

#ifdef CONFIG_RUNBMC_MCTP
    printk("  [x] MCTP Transport\n");
#else
    printk("  [ ] MCTP Transport\n");
#endif

#ifdef CONFIG_RUNBMC_FRU
    printk("  [x] FRU Management\n");
#else
    printk("  [ ] FRU Management\n");
#endif

    printk("====================================================\n\n");

    /* Small delay to let banner complete before threads start logging */
    k_msleep(10);

    /* Initialize platform */
    LOG_INF("Initializing platform...");
    int ret = platform_init();
    if (ret != 0) {
        LOG_ERR("Platform init failed: %d", ret);
        return ret;
    }

    /* Initialize BMC core (this starts all threads) */
    LOG_INF("Initializing BMC core...");
    ret = bmc_core_init();
    if (ret != 0) {
        LOG_ERR("BMC core init failed: %d", ret);
        return ret;
    }

    LOG_INF("RunBMC initialization complete");
    LOG_INF("Type 'bmc help' in shell for commands");

    return 0;
}
```
